## main/Kconfig.projbuild
```kconfig
menu "IO Configuration"

    choice A2DP_SINK_OUTPUT
        prompt "A2DP Sink Output"
        default A2DP_SINK_OUTPUT_EXTERNAL_I2S
        help
            Select to use Internal DAC or external I2S driver

        config A2DP_SINK_OUTPUT_INTERNAL_DAC
            bool "Internal DAC"
            help
                Select this to use Internal DAC sink output

        config A2DP_SINK_OUTPUT_EXTERNAL_I2S
            bool "External I2S Codec"
            help
                Select this to use External I2S sink output

    endchoice

    config I2S_LRCK_PIN
        int "I2S LRCK (WS) GPIO"
        default 25
        depends on A2DP_SINK_OUTPUT_EXTERNAL_I2S
        help
            GPIO number to use for I2S LRCK(WS) Driver.

    config I2S_BCK_PIN
        int "I2S BCK GPIO"
        default 27
        depends on A2DP_SINK_OUTPUT_EXTERNAL_I2S
        help
            GPIO number to use for I2S BCK Driver.

    config I2S_DATA_PIN
        int "I2S DATA GPIO"
        default 26
        depends on A2DP_SINK_OUTPUT_EXTERNAL_I2S
        help
            GPIO number to use for I2S Data Driver.

    config I2C_MASTER_SCL
        int "SCL GPIO Num"
        default 19
        help
            GPIO number for I2C Master clock line.

    config I2C_MASTER_SDA
        int "SDA GPIO Num"
        default 18
        help
            GPIO number for I2C Master data line.

    config I2C_MASTER_PORT_NUM
        int "Port Number"
        default 0
        help
            Port number for I2C Master device.

    config I2C_MASTER_FREQUENCY
        int "Master Frequency"
        default 100000
        help
            I2C Speed of Master device.


    config BUTTON_PLUS_PIN
        int "Button plus GPIO"
        default 23
        help
            GPIO number to use for plus push button.
    config BUTTON_MINUS_PIN
        int "Button minus GPIO"
        default 22
        help
            GPIO number to use for minus push button.

    config LONG_PRESS_DURATION
        int "button long press duration (ms)"
        default 1500
        help
            hold time to accept button long press


endmenu
```
